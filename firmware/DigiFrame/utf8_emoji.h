/* DigiFrame � UTF-8 Emoji Engine */
#pragma once

#include <Arduino.h>

const uint16_t EMOJI_HEART[64] PROGMEM = {
  0x0000, 0xF800, 0xF800, 0x0000, 0xF800, 0xF800, 0x0000, 0x0000, 0xF800, 0xF800, 0xF800, 0xF800,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 0x0000
};

const uint16_t EMOJI_WARNING[64] PROGMEM = {
  0x0000, 0x0000, 0x0000, 0x0000, 0xFFE0, 0x0000, 0x0000, 0x0000, 0x0000, 0x0000, 0x0000, 0xFFE0,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 0x0000
};

const uint16_t EMOJI_TRASH[64] PROGMEM = {
  0x0000, 0x8410, 0x8410, 0x8410, 0x8410, 0x8410, 0x8410, 0x0000, 0xCE59, 0xCE59, 0xCE59, 0xCE59,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 0x0000
};

const uint16_t EMOJI_TOOTH[64] PROGMEM = {
  0x0000, 0xFFFF, 0xFFFF, 0x0000, 0x0000, 0xFFFF, 0xFFFF, 0x0000, 0xFFFF, 0xFFFF, 0xFFFF, 0xFFFF,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 0x0000
};

const uint16_t EMOJI_CLOUD[64] PROGMEM = {
  0x0000, 0x0000, 0x0000, 0x0000, 0x0000, 0x0000, 0x0000, 0x0000, 0x0000, 0x0000, 0x0000, 0x0000,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 0x0000
};

const uint16_t EMOJI_SUN[64] PROGMEM = {
  0x0000, 0xFFE0, 0x0000, 0x0000, 0xFFE0, 0x0000, 0x0000, 0xFFE0, 0x0000, 0x0000, 0xFFE0, 0xFFE0,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 0xFFE0
};

const uint16_t EMOJI_PARTY[64] PROGMEM = {
  0x0000, 0x07FF, 0x07FF, 0xFC00, 0xFC00, 0xFFE0, 0xFFE0, 0x0000, 0x07FF, 0x07FF, 0xFFFF, 0xFFFF,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 0x0000
};

const uint16_t EMOJI_CAKE[64] PROGMEM = {
  0x0000, 0x0000, 0x0000, 0xFC00, 0x0000, 0x0000, 0x0000, 0x0000, 0x0000, 0x0000, 0x0000, 0xFFE0,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 0x0000
};

const uint16_t EMOJI_LAUGH[64] PROGMEM = {
  0x0000, 0x0000, 0xFFE0, 0xFFE0, 0xFFE0, 0xFFE0, 0x0000, 0x0000, 0x0000, 0xFFE0, 0xFFE0, 0xFFE0,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 0x0000
};

const uint16_t EMOJI_THERMOMETER[64] PROGMEM = {
  0x0000, 0x0000, 0x0000, 0xFFFF, 0xFFFF, 0x0000, 0x0000, 0x0000, 0x0000, 0x0000, 0xFFFF, 0xF800,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 0x0000
};

// Map of Unicode codepoint to Emoji Bitmap
struct EmojiMap {
  uint32_t codepoint;
  const uint16_t* bitmap;
};

const EmojiMap emojiList[] = {
  { 0x2764, EMOJI_HEART },
  { 0x26A0, EMOJI_WARNING },
  { 0x1F5D1, EMOJI_TRASH },
  { 0x1F973, EMOJI_PARTY },
  { 0x1F9B7, EMOJI_TOOTH },
  { 0x2601, EMOJI_CLOUD },
  { 0x2600, EMOJI_SUN },
  { 0x1F321, EMOJI_THERMOMETER },
  { 0x1F382, EMOJI_CAKE },
  { 0x1F602, EMOJI_LAUGH }
};
const int numEmojis = sizeof(emojiList) / sizeof(emojiList[0]);

const uint16_t* getEmojiBitmap(uint32_t codepoint) {
  for (int i = 0; i < numEmojis; i++) {
    if (emojiList[i].codepoint == codepoint) return emojiList[i].bitmap;
  }
  return nullptr;
}

// Draw a UTF-8 string to dma, handling emojis. Returns the x-coordinate after drawing.
int drawUTF8Text(int startX, int startY, const String &text, uint8_t text_size = 1) {
  int i = 0;
  int len = text.length();
  int x = startX;
  int y = startY;
  
  // Save current cursor and size
  dma->setTextSize(text_size);
  
  while (i < len) {
    uint8_t c = text[i];
    if (c == '\n') {
      x = startX;
      y += 8 * text_size + (text_size > 1 ? 2 : 1);
      i += 1;
    } else if (c < 0x80) {
      // 1-byte ASCII
      dma->setCursor(x, y);
      dma->print((char)c);
      x += 6 * text_size;
      i += 1;
    } else if ((c & 0xE0) == 0xC0) {
      // 2-byte UTF-8
      if (i + 1 < len) {
        uint32_t cp = ((c & 0x1F) << 6) | (text[i+1] & 0x3F);
        const uint16_t* bmp = getEmojiBitmap(cp);
        if (bmp) {
          dma->drawRGBBitmap(x, y, bmp, 8, 8);
          x += 9; // 8 px + 1 px spacing
        } else {
          // German Umlauts -> CP437 mappings for standard Adafruit Font
          uint8_t mapped_cp437 = 0;
          if (cp == 0x00C4) mapped_cp437 = 0x8E; // Ä
          else if (cp == 0x00D6) mapped_cp437 = 0x99; // Ö
          else if (cp == 0x00DC) mapped_cp437 = 0x9A; // Ü
          else if (cp == 0x00E4) mapped_cp437 = 0x84; // ä
          else if (cp == 0x00F6) mapped_cp437 = 0x94; // ö
          else if (cp == 0x00FC) mapped_cp437 = 0x81; // ü
          else if (cp == 0x00DF) mapped_cp437 = 0xE1; // ß
          
          if (mapped_cp437) {
            dma->setCursor(x, y);
            dma->print((char)mapped_cp437);
            x += 6 * text_size;
          }
        }
      }
      i += 2;
    } else if ((c & 0xF0) == 0xE0) {
      // 3-byte UTF-8
      if (i + 2 < len) {
        uint32_t cp = ((c & 0x0F) << 12) | ((text[i+1] & 0x3F) << 6) | (text[i+2] & 0x3F);
        const uint16_t* bmp = getEmojiBitmap(cp);
        if (bmp) {
          dma->drawRGBBitmap(x, y, bmp, 8, 8);
          x += 9;
        } else if (cp == 0xFE0F) { // Variation selector 16, just skip
          // Do not increment x
        } else {
          x += 6 * text_size;
        }
      }
      i += 3;
    } else if ((c & 0xF8) == 0xF0) {
      // 4-byte UTF-8
      if (i + 3 < len) {
        uint32_t cp = ((c & 0x07) << 18) | ((text[i+1] & 0x3F) << 12) | ((text[i+2] & 0x3F) << 6) | (text[i+3] & 0x3F);
        const uint16_t* bmp = getEmojiBitmap(cp);
        if (bmp) {
          dma->drawRGBBitmap(x, y, bmp, 8, 8);
          x += 9;
        } else {
          x += 6 * text_size;
        }
      }
      i += 4;
    } else {
      // invalid byte
      i += 1;
    }
  }
  return x;
}

// Measure the pixel width of a UTF-8 string for scrolling logic
int getUTF8TextWidth(const String &text, uint8_t text_size = 1) {
  int max_width = 0;
  int current_width = 0;
  int i = 0;
  int len = text.length();
  
  while (i < len) {
    uint8_t c = text[i];
    if (c == '\n') {
      if (current_width > max_width) max_width = current_width;
      current_width = 0;
      i += 1;
    } else if (c < 0x80) {
      current_width += 6 * text_size;
      i += 1;
    } else if ((c & 0xE0) == 0xC0) {
      uint32_t cp = ((c & 0x1F) << 6) | (text[i+1] & 0x3F);
      if (getEmojiBitmap(cp)) {
          current_width += 9;
      } else {
          // Check for German Umlauts
          if (cp == 0x00C4 || cp == 0x00D6 || cp == 0x00DC || 
              cp == 0x00E4 || cp == 0x00F6 || cp == 0x00FC || cp == 0x00DF) {
              current_width += 6 * text_size;
          }
      }
      i += 2;
    } else if ((c & 0xF0) == 0xE0) {
      uint32_t cp = ((c & 0x0F) << 12) | ((text[i+1] & 0x3F) << 6) | (text[i+2] & 0x3F);
      if (getEmojiBitmap(cp)) current_width += 9;
      else if (cp != 0xFE0F) current_width += 6 * text_size;
      i += 3;
    } else if ((c & 0xF8) == 0xF0) {
      uint32_t cp = ((c & 0x07) << 18) | ((text[i+1] & 0x3F) << 12) | ((text[i+2] & 0x3F) << 6) | (text[i+3] & 0x3F);
      if (getEmojiBitmap(cp)) current_width += 9; else current_width += 6 * text_size;
      i += 4;
    } else {
      i += 1;
    }
  }
  if (current_width > max_width) max_width = current_width;
  return max_width;
}

